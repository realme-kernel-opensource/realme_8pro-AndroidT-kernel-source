/* Copyright (c) 2018, The Linux Foundation. All rights reserved.
 *
 * This program is free software; you can redistribute it and/or modify
 * it under the terms of the GNU General Public License version 2 and
 * only version 2 as published by the Free Software Foundation.
 *
 * This program is distributed in the hope that it will be useful,
 * but WITHOUT ANY WARRANTY; without even the implied warranty of
 * MERCHANTABILITY or FITNESS FOR A PARTICULAR PURPOSE.  See the
 * GNU General Public License for more details.
 */

/dts-v1/;
/plugin/;

#include <dt-bindings/clock/qcom,gcc-sm8150.h>
#include <dt-bindings/clock/qcom,camcc-sm8150.h>
#include <dt-bindings/clock/qcom,rpmh.h>
#include <dt-bindings/interrupt-controller/arm-gic.h>

#include "sm8150-mtp.dtsi"

#include "sdx5xm-external-soc.dtsi"
#include "sm8150-sdxprairie.dtsi"
#include "sm8150-mtp-audio-overlay.dtsi"
#include "sm8150-oem-camera-hotdog-t0.dtsi"
#include "hotdogg-sdx55m-ois.dtsi"

#include "sm8150-oem.dtsi"
#include "hotdog.dtsi"
#include "hotdogg-sdx55m.dtsi"
#include "hotdog_pvt.dtsi"

/ {
	model = "SDX55M MTP 19861 53 54";
	compatible = "qcom,sm8150-mtp", "qcom,sm8150", "qcom,mtp";
	qcom,board-id = <8 2>;
	oem,project-id = <19861>;
	oem,hw-id = <53 54>;
	oplus,dtsi_no = <19861>;
	oplus,pcb_range = <53 54>;
};
